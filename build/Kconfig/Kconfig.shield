## build/Kconfig/Kconfig.shield
```kconfig
osource "c:/Users/ivpi/mytestfolder/Check_signal/boards/shields/*/Kconfig.shield"
osource "c:/Users/ivpi/mytestfolder/CS_shell/boards/shields/*/Kconfig.shield"
osource "C:/Users/ivpi/ncs/v1.9.1/nrf/boards/shields/*/Kconfig.shield"
```

## build_2/Kconfig/Kconfig.shield.defconfig
```kconfig
osource "c:/Users/ivpi/mytestfolder/CS_shell/boards/shields/*/Kconfig.defconfig"
osource "C:/Users/ivpi/ncs/v1.9.1/nrf/boards/shields/*/Kconfig.defconfig"
```
